#define DATAOUT 11//MOSI
#define DATAIN  12//MISO 
#define SPICLOCK  13//sck
#define SLAVESELECT 10//ss

//opcodes
#define WREN  6
#define WRDI  4
#define RDSR  5
#define WRSR  1
#define READ  3
#define WRITE 2


#define SIZE 1024

byte eeprom_output_data;
byte eeprom_input_data=0;
byte clr;
int address=0;
// USE THE OUTPUT OF THE 'python3 read_file.py'
byte buffer[SIZE] = {5, 25, 8, 7, 255, 174, 0, 129, 39, 1, 129, 255, 255,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 255, 255};

char spi_transfer(volatile char data) {
  SPDR = data;                    // Start the transmission
  while (!(SPSR & (1<<SPIF))) {
    // Wait the end of the transmission
  };
  return SPDR;                    // return the received byte
}

void setup() {
  Serial.begin(19200);

  pinMode(DATAOUT, OUTPUT);
  pinMode(DATAIN, INPUT);
  pinMode(SPICLOCK,OUTPUT);
  pinMode(SLAVESELECT,OUTPUT);

  digitalWrite(SLAVESELECT,HIGH); //disable device

  // SPCR = 01010000

  //interrupt disabled,spi enabled,msb 1st,master,clk low when idle,

  //sample on leading edge of clk,system clock/4 rate (fastest)

  SPCR = (1<<SPE)|(1<<MSTR);

  clr=SPSR;

  clr=SPDR;

  delay(10);
}

void fill_buffer_with_test_data(char* buffer) {
  for (int i=0;i<SIZE;i++) {
    buffer[i]=i;
  }
}

void write_eeprom(int address, char data) {
  digitalWrite(SLAVESELECT,LOW);

  spi_transfer(WREN); //write enable

  digitalWrite(SLAVESELECT,HIGH);

  delay(10);

  digitalWrite(SLAVESELECT,LOW);

  spi_transfer(WRITE); //write instruction

  spi_transfer((char)(address>>8));   //send MSByte address first

  spi_transfer((char)(address));      //send LSByte address

  spi_transfer(data); //write data byte

  digitalWrite(SLAVESELECT,HIGH); //release chip

  //wait for eeprom to finish writing

  delay(30);
}

void write_buffer(int address, char *buffer) {
  for (int i=0;i<SIZE;i++) {
    write_eeprom(address+i, buffer[i]);
  }
}

byte read_eeprom(int EEPROM_address) {
  //READ EEPROM

  int data;

  digitalWrite(SLAVESELECT,LOW);

  spi_transfer(READ); //transmit read opcode

  spi_transfer((char)(EEPROM_address>>8));   //send MSByte address first

  spi_transfer((char)(EEPROM_address));      //send LSByte address

  data = spi_transfer(0xFF); //get data byte

  digitalWrite(SLAVESELECT,HIGH); //release chip, signal end transfer

  return data;
}

void print_content(boolean human) {
   char ch[30];
    for (uint16_t i=0;i<1024;i++){       //how deep to read
      if ((i%16)==0 && human) { 
        sprintf(ch,"\n0x%03X:",i);
        Serial.print(ch);
      }
      if (human) {
        sprintf(ch,"%02X ",read_eeprom(i));
      } else {
        sprintf(ch,"%02X",read_eeprom(i));
      }
      Serial.print(ch);  //prints each byte
    }
}

void loop()
{
  print_content(true);
// testing, fill eeprom with test data
//  fill_buffer_with_test_data(buffer);

// uncomment these two lines to write and check the write result
//  write_buffer(0, buffer);
//  print_content(true);

  delay(1000000);
}
